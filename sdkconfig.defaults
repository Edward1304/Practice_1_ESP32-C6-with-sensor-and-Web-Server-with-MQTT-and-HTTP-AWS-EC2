## sdkconfig.defaults
```kconfig
# Configuración por defecto del proyecto ESP32-C6 + DHT11
# Autor: Edward Fabian Goyeneche Velandia
# Universidad Nacional de Colombia - Sede Manizales
# Grupo Percepción de Control Inteligente
# Asignatura: Desarrollo de Sistemas IoT
# Período: 2025-II

CONFIG_IDF_TARGET_ESP32C6=y

# Configuración de particiones
CONFIG_PARTITION_TABLE_CUSTOM=y
CONFIG_PARTITION_TABLE_CUSTOM_FILENAME="partitions.csv"

# Configuración WiFi
CONFIG_ESP_WIFI_SSID="TU_WIFI_SSID"
CONFIG_ESP_WIFI_PASSWORD="TU_WIFI_PASSWORD"

# Configuración LWIP
CONFIG_LWIP_PPP_SUPPORT=y

# Configuración HTTP
CONFIG_HTTPD_MAX_REQ_HDR_LEN=1024
CONFIG_HTTPD_MAX_URI_LEN=512

# Configuración MQTT
CONFIG_MQTT_PROTOCOL_311=y
CONFIG_MQTT_TRANSPORT_SSL=y
CONFIG_MQTT_TRANSPORT_WEBSOCKET=y

# Configuración de logging
CONFIG_LOG_DEFAULT_LEVEL_INFO=y

# Configuración ADC
CONFIG_ADC_ONESHOT_CTRL_FUNC_IN_IRAM=y

# Configuración de memoria
CONFIG_ESP_MAIN_TASK_STACK_SIZE=8192
CONFIG_ESP_SYSTEM_EVENT_TASK_STACK_SIZE=4096

# JSON support
CONFIG_JSON_MAXIMUM_DEPTH=32

# SPIFFS Configuration
CONFIG_SPIFFS_MAX_PARTITIONS=3
CONFIG_SPIFFS_CACHE=y
CONFIG_SPIFFS_CACHE_WR=y
CONFIG_SPIFFS_PAGE_CHECK=y
```
